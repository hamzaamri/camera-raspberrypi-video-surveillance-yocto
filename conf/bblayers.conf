## conf/bblayers.conf
```bitbake
# POKY_BBLAYERS_CONF_VERSION is increased each time build/conf/bblayers.conf
# changes incompatibly
POKY_BBLAYERS_CONF_VERSION = "2"

BBPATH = "${TOPDIR}"
BBFILES ?= ""

BBLAYERS ?= " \
  /home/hamza/yocto/layers/poky/meta \
  /home/hamza/yocto/layers/poky/meta-poky \
  /home/hamza/yocto/layers/poky/meta-yocto-bsp \
  /home/hamza/yocto/layers/meta-raspberrypi \
  /home/hamza/yocto/camera-ip/meta-custom \
  "
```

## conf/local.conf
```bitbake
#
# There are also the following hardware board target machines included for 
# demonstration purposes:
#
#MACHINE ?= "beaglebone-yocto"
#MACHINE ?= "genericarm64"
#MACHINE ?= "genericx86"
#MACHINE ?= "genericx86-64"
#
# This sets the default machine to be qemux86-64 if no other machine is selected:
MACHINE ??= "camera-rpi2"




DISTRO ?= "camera-distro"

EXTRA_IMAGE_FEATURES ?= "debug-tweaks"


USER_CLASSES ?= "buildstats"


PATCHRESOLVE = "noop"

#
# Disk Space Monitoring during the build
# with very exotic errors.
BB_DISKMON_DIRS ??= "\
    STOPTASKS,${TMPDIR},1G,100K \
    STOPTASKS,${DL_DIR},1G,100K \
    STOPTASKS,${SSTATE_DIR},1G,100K \
    STOPTASKS,/tmp,100M,100K \
    HALT,${TMPDIR},100M,1K \
    HALT,${DL_DIR},100M,1K \
    HALT,${SSTATE_DIR},100M,1K \
    HALT,/tmp,10M,1K"

PACKAGECONFIG:append:pn-qemu-system-native = " sdl"

# CONF_VERSION is increased each time build/conf/ changes incompatibly and is used to
# track the version of this file when it was generated. This can safely be ignored if
# this doesn't mean anything to you.
CONF_VERSION = "2"
```

## meta-custom/conf/distro/camera-distro.conf
```bitbake
require conf/distro/poky.conf

DISTRO="camera-distro"

DISTRO_FEATURES:append = "alsa pulseaudio x11"

INIT_MANAGER="systemd"
IMAGE_FEATURES:append = " ssh-server-openssh"
```

## meta-custom/conf/machine/camera-rpi3.conf
```bitbake
require conf/machine/raspberrypi3.conf

MACHINE_FEATURES:remove="apm keyboard vfat touchscreen alsa bluetooth sdio"

MACHINE_FEATURES:append = " vc4graphics i2c spi uart camera "
ENABLE_UART = "1"
ENABLE_SPI_BUS = "1"
ENABLE_I2C = "1"
VIDEO_CAMERA = "1"
VC4GRAPHICS = "1"

MACHINEOVERRIDES =. "raspberrypi3:"
```
